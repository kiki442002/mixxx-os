## meta-mixxx/conf/distro/mixxx-os.conf
```bitbake
DISTRO = "mixxx-os"
DISTRO_NAME = "Mixxx OS"
DISTRO_VERSION = "1.0"
DISTRO_CODENAME = "scarthgap"
TARGET_VENDOR = "-mixxx"

# Tool chain settings
TCMODE = "default"
TCLIBC  = "musl"

# Parallel build settings
BB_NUMBER_THREADS ?= "${@oe.utils.cpu_count()}"
PARALLEL_MAKE ?= "-j ${@oe.utils.cpu_count()}"

INHIBIT_DEFAULT_DEPS = ""
IMAGE_LINGUAS = ""
REPRODUCIBLE_BUILDS = "1"


DISTRO_FEATURES = " \
    acl \
    ext2 \
    vfat \
    ipv4 \
    ipv6 \
    largefile \
    opengl \
    pam \
    usbhost \
    wayland \
    wifi \
    xattr \
    zeroconf \
    sysvinit \
    alsa \
    touchscreen \
    x11 \
"

# Accept restricted licenses for RPi firmware
LICENSE_FLAGS_ACCEPTED = "synaptics-killswitch commercial"

# sysvinit as init manager
VIRTUAL-RUNTIME_init_manager = "sysvinit"
VIRTUAL-RUNTIME_initscripts = "initscripts"
DISTRO_FEATURES_BACKFILL_CONSIDERED:append = " pulseaudio"
```

## meta-mixxx/conf/layer.conf
```bitbake
BBPATH .= ":${LAYERDIR}"

BBFILES += "${LAYERDIR}/recipes-*/*/*.bb \
            ${LAYERDIR}/recipes-*/*/*.bbappend"

BBFILE_COLLECTIONS += "meta-mixxx"
BBFILE_PATTERN_meta-mixxx = "^${LAYERDIR}/"
BBFILE_PRIORITY_meta-mixxx = "6"

LAYERDEPENDS_meta-mixxx = "core raspberrypi"
LAYERSERIES_COMPAT_meta-mixxx = "scarthgap"
```
